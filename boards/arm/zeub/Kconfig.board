## boards/arm/zeub/Kconfig.board
```kconfig
# Zeub board configuration

# Copyright (c) 2020 Tobias Svehagen
# SPDX-License-Identifier: Apache-2.0

config BOARD_ZEUB
	bool "Zeub"
	depends on SOC_NRF52840_QIAA
```

## boards/arm/zeub/Kconfig.defconfig
```kconfig
# Zeub board configuration

# Copyright (c) 2020 Tobias Svehagen
# SPDX-License-Identifier: Apache-2.0

DT_COMPAT_TMP117 := ti,tmp116
DT_COMPAT_SSD1306 := solomon,ssd1306fb

if BOARD_ZEUB

config BOARD
	default "zeub"

config BT_CTLR
	default BT

config TMP116
	default $(dt_compat_enabled,$(DT_COMPAT_TMP117))

config SSD1306
	default $(dt_compat_enabled,$(DT_COMPAT_SSD1306))

config I2C
    default y

endif # BOARD_ZEUB
```

## drivers/Kconfig
```kconfig
# Copyright (c) 2020 The ZMK Contributors
# SPDX-License-Identifier: MIT

rsource "ec11/Kconfig"
rsource "battery/Kconfig.defconfig"

config ZEUB_KSCAN_INIT_PRIORITY
	int "Keyboard scan driver init priority"
	default 40
	help
	  Keyboard scan device driver initialization priority.

config ZEUB_KSCAN_DEBOUNCE_PRESS_MS
	int "Debounce time for key press in milliseconds."
	default -1
	help
		Global debounce time for key press in milliseconds.
		If this is -1, the debounce time is controlled by the debounce-press-ms
		Devicetree property, which defaults to 5 ms. Otherwise this overrides the
		debounce time for all key scan drivers to the chosen value.

config ZEUB_KSCAN_DEBOUNCE_RELEASE_MS
	int "Debounce time for key release in milliseconds."
	default -1
	help
		Global debounce time for key release in milliseconds.
		If this is -1, the debounce time is controlled by the debounce-release-ms
		Devicetree property, which defaults to 5 ms. Otherwise this overrides the
		debounce time for all key scan drivers to the chosen value.
```

## drivers/battery/Kconfig.defconfig
```kconfig
config ADC
    default y

config SENSOR
    default y

config EC11
    default y
```

## drivers/zephyr/dts/bindings/sensor/zeub,battery-voltage-divider.yaml
```yaml
# Copyright (c) 2020 The ZMK Contributors
# SPDX-License-Identifier: MIT

description: Battery SoC monitoring using voltage divider

compatible: "zeub,battery-voltage-divider"

include: voltage-divider.yaml

properties:
  label:
    required: true
    type: string
```
